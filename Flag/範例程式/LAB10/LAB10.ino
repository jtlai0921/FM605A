#include "FlagTA6932.h"
#include "FlagPCM.h"

const unsigned char pong [] PROGMEM = {129, 130, 129, 129, 129, 128, 128, 128, 128, 128, 128, 127, 127,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 128
};
const unsigned char failure[] PROGMEM = {130, 134, 135, 130, 119, 109, 111, 124, 145, 150, 126, 122, 156,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 128
};

FlagTA6932 myLED(12,9,8);//建立一個新的LED矩陣
int row=6;  //列的位置
int col=3;    //行的位置
int board_pos=2;  //球板位置
bool Reset=0;
bool UporDown=1; //UP:1 DOWN:0
bool LorR=0;    //Left:1 Right:0
/////////////////////parameter/////////////////
const int action=2;//AI動作
const int state=144;//狀態
const int comrate=70;//完成率
const int comnum=200;//完成數
///////////////////////////////////////////////
int Q[state][action];//Q-learning矩陣
int cordecide[state];//學習成功矩陣
int memory[22];     //記憶矩陣
int sizeofmemory=0; //當前記憶大小
int output=0;       //AI決定輸出值
int pos=128;        //當前位置
int rannum=0;       //亂數

void setup() {
  pinMode(A0,INPUT);
  pinMode(A1,INPUT);
  pinMode(13,OUTPUT);
  digitalWrite(13,0);//將PIN13腳位設為GND
  digitalWrite(10,0);//將PIN10腳位設為GND
  randomSeed(analogRead(A5));//產生亂數子
  /////////製作Q初始矩陣/////////////
  for (int i=0;i<state;i++){
    for(int j=0;j<action;j++){
      Q[i][j]=14;
    }
  }
  ////////////////////////////////////
  myLED.begin();  //初始化
  myLED.SetLightLevel(3); //設定亮度為3
  myLED.Clear();  //清除螢幕
  myLED.UpdateOneLine(0,0,255); //點亮第0列一整排的燈
  myLED.SetLed(1, row, col, 1);//點亮當前球位
  myLED.SetLed(2, 7, board_pos, 1); myLED.SetLed(2, 7, board_pos, 1); myLED.SetLed(2, 7, board_pos, 1);//點亮球板
}

void loop() {
  if(Reset==1){
    myLED.UpdateOneLine(1,6,0);//清除失誤點
    if(col==7){
      myLED.SetLed(1, 7, 6, 1);//顯示失誤落點
    }
    else{
      if(LorR==1){
        myLED.SetLed(1, 7, col-1, 1);//顯示失誤落點
      }
      else{
        myLED.SetLed(1, 7, col+1, 1);//顯示失誤落點
      }
    }
    delay(500);
    myLED.UpdateOneLine(2,7,0);//清除板子和球
    row=6;col=3;LorR=0;//重置位置
    board_pos=2;
    myLED.SetLed(2, 7, board_pos, 1); myLED.SetLed(2, 7, board_pos+1, 1); myLED.SetLed(2, 7, board_pos+2, 1);
    myLED.SetLed(1, row, col, 1);//顯示球位置
    Reset=0;
    delay(300);
  }
  else if(Reset==0){ 
    if(UporDown==1){
      row=row-1;
    if(row==0){
      row=2;
      UporDown=0;
    }
    }
    else{
      row=row+1;
    if(row==7){
      row=5;
      UporDown=1;
    }
    }
    if(LorR==0){
    col=col+1;
    if(col==8){
    col=6;
    LorR=1;
    }
    }
    else{
      col=col-1;
      if(col==-1){
        col=1;
        LorR=0;
      }
      }
      for(int i=1;i<7;i++){ //熄滅前一個球位
        myLED.UpdateOneLine (1,i,0);
      }
      myLED.SetLed(1, row, col, 1);//點亮當前球位
      pos=( 24*(row-1) )+( 4*(col-(1-row%2)) )+board_pos;//計算位置
      output=AIaction();//AI決定值

     if(output==1 && board_pos<5){//如果決定值為1，球板往右
      board_pos +=1;
     }
     else if(output==2 && board_pos>0){//如果決定值為2，球板往左
      board_pos -=1;
     }
      
      myLED.UpdateOneLine(2,7,0);
      myLED.SetLed(2, 7, board_pos, 1); myLED.SetLed(2, 7, board_pos +1, 1); myLED.SetLed(2, 7, board_pos +2, 1);
      
      if(row==6){
        if(col==1){
          if(board_pos==0|board_pos==1|(board_pos==2&&LorR==0) ){
            Reset=0;
          }
          else{
            Reset=1;
          }      
        }
        else if(col==3){
          if(board_pos==1|board_pos==2|board_pos==3|(board_pos==0&&LorR==1)|(board_pos==4&&LorR==0) ){
            Reset=0;
          }
          else{
            Reset=1;
          } 
        }
        else if(col==5){
          if(board_pos==3|board_pos==4|board_pos==5|(board_pos==2&&LorR==1) ){
            Reset=0;
          }
          else{
            Reset=1;
          } 
        }
        else if(col==7){
          if(board_pos==4|board_pos==5){
            Reset=0;
          }
          else{
            Reset=1;
          } 
        }
        if(Reset==0){
          startPlayback(pong, sizeof(pong));
          p_reward(50,7,2);
        }
        else if(Reset==1){
          startPlayback(failure, sizeof(failure));
          nreward(7,7,1);
        }
      }
  }
  delay(100);
}

void p_reward(int learn_rate, const int re_step ,const int discount){ //notice!! learn_rate must ≧re_step*discount
    ////preward//正回饋//(學習效率,學習步數,折扣)
    for(int i=sizeofmemory-2;i>(sizeofmemory-(re_step*2));i-=2){
      if(i>=0){
        Q[memory[i]][memory[i+1]-1]+=learn_rate; 
      }
      learn_rate-=discount;
    }
   
    for(int i=0;i<sizeofmemory;i++){
      memory[i]=0;
    }
    sizeofmemory=0;

    //////////////prewardend
}

void nreward(int learn_rate, const int re_step ,const int discount){ //notice!! learn_rate must ≧re_step*discount
  ////nreward//負回饋//(學習效率,學習步數,折扣)
   for(int i=sizeofmemory-2;i>(sizeofmemory-(re_step*2));i-=2){
      if(i>=0&&((Q[memory[i]][memory[i+1]-1])-learn_rate)>0){
        Q[memory[i]][memory[i+1]-1]-=learn_rate; 
      }
     learn_rate-=discount;
   }

   for(int i=0;i<sizeofmemory;i++){
    memory[i]=0;
  }
  sizeofmemory=0;
 
  ///////////////nrewardend
}

int AIaction(){
  int dtotal=0; //該位置的action總量
  int noutput;  //此次輸出
  
////計算該位置的action總量///  
  for(int i=0;i<action;i++){  
   dtotal=dtotal+Q[pos][i];
  }
//////////////////////////////

  int maxQ=0; //最大action

///////////大於完成數////////
  if(dtotal>comnum){
   for(int i=1;i<action;i++){
     if(Q[pos][i]>Q[pos][maxQ]){ //求最大action
        maxQ=i;
     }    
   }
   if( ((Q[pos][maxQ]*100.0f)/dtotal) >comrate){ //檢驗是否高於設定完成率
     for(int i=0;i<action;i++){  //大於完成率, 清空該位置action矩陣
      Q[pos][i]=0;
    }
    cordecide[pos]=maxQ+1; //將最大action值存進確定矩陣
    dtotal=0;
   }
   else{ 
    dtotal=0;
    for(int i=0;i<action;i++){  //小於完成率, 縮小矩陣
      Q[pos][i]=Q[pos][i]/10+1;
      dtotal=dtotal+Q[pos][i];
    }
   } 
}//end if dtotal>comnum

/////////檢驗當前位置action總值////
if(dtotal==0){  //action總值=0
  noutput=cordecide[pos]; //此次輸入為確定矩陣值
}
else{   //action矩陣不為0
  int start=0; //定位點 
  rannum=random(dtotal);  //取action範圍的亂數
  for(int i=0;i<action;i++){
    if(rannum>=start && rannum<(start+Q[pos][i])){
      noutput=i+1;
    }
    start+=Q[pos][i]; //定位
  }
  memory[sizeofmemory]=pos; //將位置存進記憶矩陣
  memory[sizeofmemory+1]=noutput; //將輸出存進記憶矩陣
  sizeofmemory=sizeofmemory+2;  //標記矩陣大小
  if(sizeofmemory==24){ //防止矩陣過大
    sizeofmemory=0;
  }
}
  return noutput; //回傳輸出值
}
